## main/Kconfig.projbuild
```kconfig
menu "Example Configuration"
    config LV_DPI_DEF
        string "Default Dots Per Inch (in px/inch)"
        default "300"

    config LV_DEF_REFR_PERIOD
        string "Default refresh period (ms)"
        default "30"

    config LV_MEM_SIZE_KILOBYTES
        string "Size of the memory used by `lv_malloc()` in kilobytes (>= 2kB)"
        default "300"

    config LV_FS_STDIO_LETTER
        string "Set an upper cased letter on which the drive will accessible (e.g. 65 for 'A')"
        default "65"

    # External decode image cache: width x height x 4
    config LV_CACHE_DEF_SIZE
        string "Default image cache size. 0 to disable caching"
        # H0410S001AMT001-V0
        default "2799104"

    config EXAMPLE_ENABLE_MIPI_CSI_CAM_SENSOR
        bool "Enable MIPI CSI Camera Sensor"
        default y
        depends on SOC_MIPI_CSI_SUPPORTED

    if EXAMPLE_ENABLE_MIPI_CSI_CAM_SENSOR
        config EXAMPLE_MIPI_CSI_SCCB_I2C_PORT
            int "MIPI CSI SCCB I2C Port Number"
            default 1
            range 0 1

        config EXAMPLE_MIPI_CSI_SCCB_I2C_SCL_PIN
            int "MIPI CSI SCCB I2C SCL Pin"
            default 21
            range -1 56

        config EXAMPLE_MIPI_CSI_SCCB_I2C_SDA_PIN
            int "MIPI CSI SCCB I2C SDA Pin"
            default 20
            range -1 56

        config EXAMPLE_MIPI_CSI_SCCB_I2C_FREQ
            int "MIPI CSI SCCB I2C Frequency"
            default 100000
            range 50000 400000
            help
                Increasing this value can reduce the initialization time of the camera sensor.
                Please refer to the relevant instructions of the camera sensor to adjust the value.

        config EXAMPLE_MIPI_CSI_CAM_SENSOR_RESET_PIN
            int "MIPI CSI Camera Sensor Reset Pin"
            default -1
            range -1 56

        config EXAMPLE_MIPI_CSI_CAM_SENSOR_PWDN_PIN
            int "MIPI CSI Camera Sensor Power Down Pin"
            default -1
            range -1 56
    endif

    config EXAMPLE_USE_MEMORY_MAPPING
        bool "Use Memory Mapping for Buffer Allocation"
        default n
        help
        Enable this option if you want to allocate memory using memory mapping.
        This is typically useful for performance optimization or when working
        with hardware that requires mapped memory access

    config EXAMPLE_CAM_BUF_COUNT
        int "Camera Buffer Count"
        default 2
        range 2 3

    choice
        prompt "Select the camera type"
        default CAMERA_TYPE_OV2710
            config CAMERA_TYPE_SC2336
                bool "SC2336"
            config CAMERA_TYPE_OV2710
                bool "OV2710"
            config CAMERA_TYPE_OV5645
                bool "OV5645"
    endchoice

    choice
        prompt "Select the screen type"
        default SCREEN_TYPE_HI8561
            config SCREEN_TYPE_HI8561
                bool "HI8561"
            config SCREEN_TYPE_RM69A10
                bool "RM69A10"
    endchoice

    config ENABLE_USB_DISPLAY
        bool "Enable USB Display"
        default n

    config ENABLE_PPA_SCREEN_ROTATION
        bool "Enable ppa screen rotation"
        default y

    choice
        prompt "Select the color format of the screen"
        default SCREEN_PIXEL_FORMAT_RGB565
            config SCREEN_PIXEL_FORMAT_RGB565
                bool "RGB565"
            config SCREEN_PIXEL_FORMAT_RGB888
                bool "RGB888"
    endchoice

    choice BOARD_TYPE
        prompt "Board type"
        default BOARD_TYPE_T_DISPLAY_P4
        config BOARD_TYPE_T_DISPLAY_P4
            bool "t_display_p4"
        config BOARD_TYPE_T_DISPLAY_P4_KEYBOARD
            bool "t_display_p4_keyboard"
    endchoice

    choice ADSB_DEMOD
        prompt "ADS-B demodulator"
        default ADSB_DEMOD_2400
        help
            Which demodulator runs, and with it the RTL-SDR sample rate.
            See docs/DECODER.md section 5.

        config ADSB_DEMOD_2400
            bool "2.4 Msps (mode_s_2400.c)"
            help
                Slices each bit from fractional sample positions, so frames
                decode whatever their timing relative to the sample clock.
                Thresholds are ratios to the noise level, not fixed values.
                In the harness it decodes about 96% of strong frames (the
                2.0 Msps demodulator: 68%) and about 60% more frames on a
                real capture. 20% more USB data and roughly 1.8x the decode
                CPU of the 2.0 Msps demodulator.

        config ADSB_DEMOD_2000
            bool "2.0 Msps (original)"
            help
                The original two-samples-per-bit demodulator. Cheaper, but
                loses about a third of frames to sample timing at any
                signal strength.
    endchoice

    config ADSB_DECODE_SOFT
        bool "Soft rescue with the known-address gate"
        depends on ADSB_DEMOD_2400
        default y
        help
            A DF17/18 frame that fails its CRC is repaired if flipping up to
            four of its eight least confident bits, and only those, accounts
            exactly for the CRC error. Accepted only for an aircraft that was
            heard error-free within the last 60 seconds, and only if its
            CA/CF field holds a valid value - so a repair extends an existing
            track and never creates one.

            On since coh2 (2026-11-18): in a stress test of 400,000
            overlapping frame pairs it delivered no more false frames than
            1-bit correction alone (docs/DECODER.md section 5.7). Never
            soaked on hardware. On the console: `adsb dec soft`; `adsb dec
            default` goes back to 1-bit correction only.

    config ADSB_DECODE_COH
        bool "Coherent second look"
        depends on ADSB_DEMOD_2400
        default y
        help
            A frame that still fails its CRC is sliced again from the I/Q
            samples on its own carrier (mode_s_coh.c, docs/DECODER.md
            section 5.7), and the soft rescue, if enabled, gets a second
            try with the better per-bit confidences that gives.

            In the harness: 16 to 22 % more frames on a real capture for
            5 to 6 % more decoder instructions, and no added false frames.
            Never measured on a device. Takes 9.6 kB of PSRAM.

            This sets the state at boot. `adsb coh on` / `adsb coh off` on
            the console switches it while the receiver runs.

    config ADSB_DECODE_FIX2
        bool "Exact 2-bit correction as well (not recommended)"
        default n
        help
            Adds exact 2-bit CRC error correction for DF17/DF18 frames to
            the above, with the same strict validation and known-address
            gate (and switches the soft rescue on with it).

            Not recommended since coh2: any two bits that satisfy the CRC
            are accepted, and in a stress test of 400,000 overlapping frame
            pairs that delivered 124 frames that were never sent, 113 of
            them under a real aircraft's address; the configuration without
            it delivered 12 (docs/DECODER.md section 5.7). With the coherent
            second look on it adds under 1 % of frames. Kept for comparison:
            `adsb dec fix2` on the console.

    # adsb-scope: this repo builds exactly one application.  The upstream
    # LilyGo tree offered ~30 examples here; the historical sdkconfig
    # selector CONFIG_EXAMPLE_BUILD_LVGL_9_UI is gone — see VENDOR.md.
    choice
        prompt "Select the application to build"
        default EXAMPLE_BUILD_ADSB_RECEIVER
        config EXAMPLE_BUILD_ADSB_RECEIVER
            bool "adsb_receiver (ADS-B Scope)"
    endchoice

endmenu
```
